## CMakeLists.txt
```
cmake_minimum_required(VERSION 3.20.0)
find_package(Zephyr REQUIRED HINTS $ENV{ZEPHYR_BASE})

project(nrf_ble_mobile)

target_include_directories(app PRIVATE inc)

target_sources(app PRIVATE
    ${ZEPHYR_BASE}/../modules/debug/segger/SEGGER/SEGGER_RTT_printf.c
    src/PROTOCOL.c
    src/packet_build.c
    src/parser.c
    src/nvs_part.c
    src/ble_part.c
    src/usb_part.c
    src/main.c
)
```

## prj.conf
```kconfig
CONFIG_USE_SEGGER_RTT=y
CONFIG_SEGGER_RTT_PRINTF_BUFFER_SIZE=16000
CONFIG_SEGGER_RTT_BUFFER_SIZE_UP=16000



CONFIG_GPIO=y



# CONFIG_HEAP_MEM_POOL_SIZE=1024



# Bluetooth
CONFIG_BT=y
CONFIG_BT_PERIPHERAL=y
CONFIG_BT_DEVICE_NAME="UHFS Demo V0.1"
# Generic watch appearance
CONFIG_BT_DEVICE_APPEARANCE=192

CONFIG_BT_HCI=y
CONFIG_BT_MAX_CONN=2

CONFIG_BT_GAP_AUTO_UPDATE_CONN_PARAMS=y

CONFIG_BT_BUF_ACL_RX_SIZE=189
CONFIG_BT_BUF_ACL_TX_SIZE=189
CONFIG_BT_L2CAP_TX_MTU=185

# Value for 4255 bytes with 185 bytes MTU
CONFIG_BT_ATT_PREPARE_COUNT=24


# Extended Advertisement
CONFIG_BT_EXT_ADV=y

CONFIG_BT_GATT_DYNAMIC_DB=y
CONFIG_BT_GATT_SERVICE_CHANGED=y

CONFIG_BT_RX_STACK_SIZE=2048



# NVS
CONFIG_FLASH=y
CONFIG_FLASH_PAGE_LAYOUT=y
CONFIG_FLASH_MAP=y

CONFIG_NVS=y

CONFIG_SETTINGS=y
CONFIG_SETTINGS_NVS=y

# Increase max size of one setting to 4096 * 2 = 8192 bytes
CONFIG_SETTINGS_NVS_SECTOR_SIZE_MULT=2



# USB CDC
CONFIG_USB_DEVICE_STACK=y
CONFIG_USB_DEVICE_PRODUCT="UHFS Demo V0.1"
CONFIG_USB_DEVICE_PID=0x0001
CONFIG_SERIAL=y
CONFIG_UART_INTERRUPT_DRIVEN=y
CONFIG_UART_LINE_CTRL=y
CONFIG_USB_DEVICE_INITIALIZE_AT_BOOT=n



# Enable nordic security backend and PSA APIs
CONFIG_NRF_SECURITY=y
CONFIG_MBEDTLS_PSA_CRYPTO_C=y

CONFIG_PSA_WANT_GENERATE_RANDOM=y
CONFIG_PSA_WANT_KEY_TYPE_AES=y
CONFIG_PSA_WANT_ALG_CBC_NO_PADDING=y



# Generate more information to generate SPDX documents later
#CONFIG_BUILD_OUTPUT_META=y
```

## src/main.c
```c
/*
 * main.c
 * src
 * 
 * Copyright (C) 2025 by UHF Solutions
 * All right reserved
 */

 
#include "main.h"


#include "nvs_part.h"
#include "parser.h"
#include "ble_part.h"
#include "usb_part.h"


int settings_init_load();

static const struct gpio_dt_spec led0_dev = GPIO_DT_SPEC_GET(DT_ALIAS(led0), gpios);


struct bt_uuid_128 UUID_TRANSPORT_SERVICE;
struct bt_uuid_128 UUID_TRANSPORT_CHARACTERISTIC_IN;
struct bt_uuid_128 UUID_TRANSPORT_CHARACTERISTIC_OUT;

uint16_t USB_RX_TIMEOUT_VALUE;
uint16_t BLE_RX_TIMEOUT_VALUE;



#include <psa/crypto.h>
#include <psa/crypto_extra.h>

void printKCV(uint8_t *kcv, uint16_t len)
{
	SEGGER_RTT_printf(0, "KCV: ");
	for (int i = 0; i < len; i++) 
	{
		if (kcv[i] < 0x10)
			SEGGER_RTT_printf(0, "0");
		SEGGER_RTT_printf(0, "%x", kcv[i]);
	}
	SEGGER_RTT_printf(0, "\n");
}

static psa_key_id_t key_id;
int crypto_init(void)
{
	if (psa_crypto_init() != PSA_SUCCESS)
	{
		SEGGER_RTT_printf(0, "PSA Init Failed!\n");
		return -1;
	}
	return 0;
}

int import_key(void)
{
	psa_status_t status;

	uint8_t key_val[] = { 0x2b, 0x7e, 0x15, 0x16, 0x28, 0xae, 0xd2, 0xa6, 0xab, 0xf7, 0x15, 0x88, 0x09, 0xcf, 0x4f, 0x3c };
	psa_key_attributes_t key_attributes = PSA_KEY_ATTRIBUTES_INIT;


	psa_set_key_usage_flags(&key_attributes, PSA_KEY_USAGE_ENCRYPT | PSA_KEY_USAGE_DECRYPT);
	psa_set_key_lifetime(&key_attributes, PSA_KEY_LIFETIME_VOLATILE);
	psa_set_key_algorithm(&key_attributes, PSA_ALG_ECB_NO_PADDING);
	psa_set_key_type(&key_attributes, PSA_KEY_TYPE_AES);
	psa_set_key_bits(&key_attributes, 128);

	
	status = psa_import_key(&key_attributes, key_val, sizeof(key_val), &key_id);
	if (status != PSA_SUCCESS) 
	{
		SEGGER_RTT_printf(0, "Key Import Failed: %d\n", status);
		return -1;
	}	

	psa_reset_key_attributes(&key_attributes);
	return 0;
}

int encrypt_cbc_aes(void)
{
	uint32_t olen;
	psa_status_t status;
	psa_cipher_operation_t operation = PSA_CIPHER_OPERATION_INIT;

	uint8_t data_in_val[] = { 0x00, 0x00, 0x00, 0x00, 0x00, 0x00, 0x00, 0x00, 0x00, 0x00, 0x00, 0x00, 0x00, 0x00, 0x00, 0x00 };
	uint8_t data_out_val[sizeof(data_in_val)];

	status = psa_cipher_encrypt_setup(&operation, key_id, PSA_ALG_ECB_NO_PADDING);
	if (status != PSA_SUCCESS) 
	{
		SEGGER_RTT_printf(0, "psa_cipher_encrypt_setup failed! (Error: %d)\n", status);
		return -1;
	}

	status = psa_cipher_update(&operation, data_in_val, sizeof(data_in_val), 
						data_out_val, sizeof(data_out_val), 
						&olen);
	if (status != PSA_SUCCESS) {
		SEGGER_RTT_printf(0, "psa_cipher_update failed! (Error: %d)\n", status);
		return -1;
	}

	status = psa_cipher_finish(&operation, data_out_val + olen,
				   sizeof(data_out_val) - olen,
				   &olen);
	if (status != PSA_SUCCESS) 
	{
		SEGGER_RTT_printf(0, "psa_cipher_finish failed! (Error: %d)\n", status);
		return -1;
	}

	printKCV(data_out_val, 4);
	psa_cipher_abort(&operation);

	return 0;
}


// *******************************************************************
// >>> MAIN <<<
// *******************************************************************

void incrementTestNotifyData(uint8_t *notify_data);
void main_thread(void)
{	
	int err = 0;

	gpio_pin_configure_dt(&led0_dev, GPIO_OUTPUT);
	gpio_pin_set_dt(&led0_dev, 1);

	crypto_init();
	import_key();
	encrypt_cbc_aes();

	while (1) 
	{
		k_msleep(10000);
	}


	settings_subsys_init();
	SEGGER_RTT_printf(0, "Save Res: %d\n", settings_init_save());

	user_data_load_uuid_service(&UUID_TRANSPORT_SERVICE);
	user_data_load_uuid_characteristic_in(&UUID_TRANSPORT_CHARACTERISTIC_IN);
	user_data_load_uuid_characteristic_out(&UUID_TRANSPORT_CHARACTERISTIC_OUT);

	user_data_load_time_usb_rx_timeout(&USB_RX_TIMEOUT_VALUE);
	user_data_load_time_ble_rx_timeout(&BLE_RX_TIMEOUT_VALUE);	


	ble_begin(BLE_RX_TIMEOUT_VALUE, &UUID_TRANSPORT_SERVICE, &UUID_TRANSPORT_CHARACTERISTIC_IN, &UUID_TRANSPORT_CHARACTERISTIC_OUT);
	usb_begin(USB_RX_TIMEOUT_VALUE);
	
	

	uint8_t battery_level = 0;
	uint8_t battery_level_status = 0;


	tUniversalMessage *notify_packet_usb;
   	tUniversalMessage *notify_packet_ble;
	uint8_t notify_data[9];

    while (1) 
    {
		// BAS
		if (battery_level >= 100)
			battery_level = 0;
		else
			battery_level += 10;
		ble_bas_set_battery_level(battery_level);

		if (battery_level_status >= 0x0F)
			battery_level_status = 0;
		else
			battery_level_status++;
		ble_bas_set_battery_level_status(battery_level_status);	

		// TRANSPORT
		incrementTestNotifyData(notify_data);
		
		// Notify Test USB
		notify_packet_usb = k_heap_alloc(&UniversalTransportHeap, sizeof(tUniversalMessage), K_NO_WAIT);
		notify_packet_usb->length = 9;
		notify_packet_usb->data = k_heap_alloc(&UniversalTransportHeap, notify_packet_usb->length, K_NO_WAIT); 
		for (int i = 0; i < notify_packet_usb->length; i++)
			notify_packet_usb->data[i] = notify_data[i];

		notify_packet_usb->source = MESSAGE_SOURCE_USB;
		err = k_msgq_put(&usb_queue_tx, &notify_packet_usb, K_NO_WAIT);
        if (err != 0) SEGGER_RTT_printf(0, " --- USB TX ERR --- :  USB TX Queue put error: %d\n", err);

		// Notify Test BLE
		for (int i = 0; i < CONFIG_BT_MAX_CONN; i++) 
		{
			notify_packet_ble = k_heap_alloc(&UniversalTransportHeap, sizeof(tUniversalMessage), K_NO_WAIT);
			notify_packet_ble->length = 9;
			notify_packet_ble->data = k_heap_alloc(&UniversalTransportHeap, notify_packet_ble->length, K_NO_WAIT); 
			for (int i = 0; i < notify_packet_ble->length; i++)
				notify_packet_ble->data[i] = notify_data[i];

			notify_packet_ble->source = MESSAGE_SOURCE_BLE_CONNS + i;
			err = k_msgq_put(&ble_queue_tx, &notify_packet_ble, K_NO_WAIT);
        	if (err != 0) SEGGER_RTT_printf(0, " --- BLE TX ERR --- : BLE TX Queue put error: %d\n", err);
		}
		

		k_msleep(10000);
    }   	
}

K_THREAD_DEFINE(main_thread_id, THREAD_STACK_SIZE_MAIN, main_thread, NULL, NULL, NULL,
		THREAD_PRIORITY_MAIN, 0, 0);



void incrementTestNotifyData(uint8_t *notify_data) 
{
	static uint8_t TestNotifyValue = 255;
	TestNotifyValue++;

	notify_data[PROTOCOL_INDEX_PREAMBLE] 	= PROTOCOL_PREAMBLE;
	notify_data[PROTOCOL_INDEX_MSG_TYPE] 			= PROTOCOL_MSG_TYPE_PR_NOTIFY;
	notify_data[PROTOCOL_INDEX_MSG_CODE] 			= 0;

	notify_data[PROTOCOL_INDEX_PL_LEN_MSB] 		= 0;
	notify_data[PROTOCOL_INDEX_PL_LEN_LSB] 	= 1;

	notify_data[PROTOCOL_INDEX_PL_START] 	= TestNotifyValue;

	notify_data[PROTOCOL_INDEX_PL_START+1] 	= PROTOCOL_END_MARK;

	uint16_t crcCalculatedBuf = calculateCRC(notify_data, PROTOCOL_INDEX_PL_START+2);
	notify_data[PROTOCOL_INDEX_PL_START+2] 	= crcCalculatedBuf & 0x00FF;
	crcCalculatedBuf >>= 8;
	notify_data[PROTOCOL_INDEX_PL_START+3] 	= crcCalculatedBuf & 0x00FF;
}
```

## src/main.cpp
```c
#include "main.h"
#include "ble_part.h"
#include "nvs_part.h"

static const struct gpio_dt_spec led0_dev = GPIO_DT_SPEC_GET(DT_ALIAS(led0), gpios);



//#define NVS_NEED_CONFIGURE // <-- Загружает настройки в NVS: сохраняет сервисов/характеристик UUID

/*
	TODO:
	1) BLE. Добавить и потестить возможность подключения нескольких устройств
	2) USB. Добавить и потестить USB CDC реализацию
	3) Реализовать структуру как на схеме
	4) Реализовать тестовый пример для всего этого дела из текста задания
*/


static bt_uuid_128 UUID_TRANSPORT_SERVICE;
static bt_uuid_128 UUID_TRANSPORT_CHARACTERISTIC_IN;
static bt_uuid_128 UUID_TRANSPORT_CHARACTERISTIC_OUT;


// *******************************************************************
// >>> MAIN <<<
// *******************************************************************

int main(void)
{
	gpio_pin_configure_dt(&led0_dev, GPIO_OUTPUT);
	gpio_pin_set_dt(&led0_dev, 1);


	nvs_begin();

#ifdef NVS_NEED_CONFIGURE
	struct bt_uuid_128 uuids[3] = 
	{
		BT_UUID_INIT_128(BT_UUID_128_ENCODE(0xD134A7E0, 0x1824, 0x4A94, 0xAB73, 0x0637ABC923DF)),
		BT_UUID_INIT_128(BT_UUID_128_ENCODE(0xD134A7E1, 0x1824, 0x4A94, 0xAB73, 0x0637ABC923DF)),
		BT_UUID_INIT_128(BT_UUID_128_ENCODE(0xD134A7E2, 0x1824, 0x4A94, 0xAB73, 0x0637ABC923DF)),

	};

	add_uuid(&uuids[0]);
	add_uuid(&uuids[1]);
	add_uuid(&uuids[2]);
#endif

	get_uuid(0, &UUID_TRANSPORT_SERVICE);
	get_uuid(1, &UUID_TRANSPORT_CHARACTERISTIC_IN);
	get_uuid(2, &UUID_TRANSPORT_CHARACTERISTIC_OUT);
		
	ble_begin(&UUID_TRANSPORT_SERVICE, &UUID_TRANSPORT_CHARACTERISTIC_IN, &UUID_TRANSPORT_CHARACTERISTIC_OUT);


	uint8_t battery_level = 0;
	uint8_t battery_level_status = 0;
    while (1) 
    {
		k_msleep(10000);

		if (battery_level >= 100)
			battery_level = 0;
		else
			battery_level += 10;
		ble_bas_set_battery_level(battery_level);

		if (battery_level_status >= 0x0F)
			battery_level_status = 0;
		else
			battery_level_status++;
		ble_bas_set_battery_level_status(battery_level_status);	
    }   	

	return 0;
}
```

## inc/PROTOCOL.h
```c
/*
 * PROTOCOL.h
 * inc
 * 
 * Copyright (C) 2025 by UHF Solutions
 * All right reserved
 */


#pragma once

#include <stdint.h>
#include <zephyr/kernel.h>



#define UNIVERSAL_TRANSPORT_HEAP_SIZE	16384

#define QUEUE_SIZE_USB_TX	64
#define QUEUE_SIZE_BLE_TX	32

#define QUEUE_SIZE_PARSER	16



extern struct k_heap UniversalTransportHeap;

typedef enum 
{
	MESSAGE_SOURCE_USB = 0,
	MESSAGE_SOURCE_BLE_CONNS,
} tMessageSources;

typedef struct
{
	tMessageSources source; // Номер источника. Всё, что >= MESSAGE_SOURCE_BLE_CONNS - индексы BLE подключений

	uint8_t *data;  		// Указатель на передаваемое сообщение 
	uint16_t length;		// Длина передаваемого сообщения
} tUniversalMessage;


typedef struct 
{
	tUniversalMessage *rxPacket;

	uint16_t payloadLength;
	uint16_t checksumBuffer;
} tParcingContext;



void freeUniversalMessage(tUniversalMessage *packet);
void freeParcingContex(tParcingContext *context);



#define PROTOCOL_PREAMBLE 0xBB
#define PROTOCOL_END_MARK 0x7E


#define PROTOCOL_INDEX_PREAMBLE		0
#define PROTOCOL_INDEX_MSG_TYPE		1
#define PROTOCOL_INDEX_MSG_CODE		2
#define PROTOCOL_INDEX_PL_LEN_MSB	3
#define PROTOCOL_INDEX_PL_LEN_LSB	4
#define PROTOCOL_INDEX_PL_START		5

#define PROTOCOL_END_PART_SIZE	3 // End Mark + CRC


#define PROTOCOL_MAX_PL_PACKET_LENGTH	4096
#define PROTOCOL_MAX_PACKET_LENGTH		PROTOCOL_INDEX_PL_START + PROTOCOL_MAX_PL_PACKET_LENGTH + PROTOCOL_END_PART_SIZE


//  Типы
#define PROTOCOL_MSG_TYPE_PR_COMMAND	0x00
#define PROTOCOL_MSG_TYPE_PR_ANSWER		0x01
#define PROTOCOL_MSG_TYPE_PR_NOTIFY		0x02

#define PROTOCOL_MSG_TYPE_COMMAND		0xE0
#define PROTOCOL_MSG_TYPE_ANSWER		0xE1
#define PROTOCOL_MSG_TYPE_NOTIFY		0xE2

#define PROTOCOL_MSG_TYPE_CRISP_COMMAND	0xE5
#define PROTOCOL_MSG_TYPE_CRISP_ANSWER	0xE6
#define PROTOCOL_MSG_TYPE_CRISP_NOTIFY	0xE7

#define PROTOCOL_MSG_TYPES { PROTOCOL_MSG_TYPE_PR_COMMAND, PROTOCOL_MSG_TYPE_PR_ANSWER, PROTOCOL_MSG_TYPE_PR_NOTIFY, \
						PROTOCOL_MSG_TYPE_COMMAND, PROTOCOL_MSG_TYPE_ANSWER, PROTOCOL_MSG_TYPE_NOTIFY, \
						PROTOCOL_MSG_TYPE_CRISP_COMMAND, PROTOCOL_MSG_TYPE_CRISP_ANSWER, PROTOCOL_MSG_TYPE_CRISP_NOTIFY }


//  Коды
#define PROTOCOL_MSG_CODE_GET_DEVICE_INFO		0x01
#define PROTOCOL_MSG_CODE_DO_SELF_CHECK			0x02
#define PROTOCOL_MSG_CODE_GET_ALL_USR_SETTINGS	0x10
#define PROTOCOL_MSG_CODE_GET_USR_SETTING		0x11
#define PROTOCOL_MSG_CODE_SET_USR_SETTING		0x12
#define PROTOCOL_MSG_CODE_GET_BATTERY_INFO		0x13
#define PROTOCOL_MSG_CODE_SET_SYSTEM_MODE		0x20
#define PROTOCOL_MSG_CODE_SET_SYSTEM_REG		0xF0
#define PROTOCOL_MSG_CODE_SET_LIFE_CYCLE		0xF1

// Результаты
#define PROTOCOL_RES_OK									0x0000
#define PROTOCOL_RES_HUK_VERIFICATION_ERROR				0x6401
#define PROTOCOL_RES_MEMORY_WRITE_ERROR					0x6501
#define PROTOCOL_RES_MEMORY_ERROR						0x6581
#define PROTOCOL_RES_RECEIVING_TIMEOUT_ERROR			0x6600
#define PROTOCOL_RES_RECEIVING_CRC_ERROR				0x6602
#define PROTOCOL_RES_WRONG_LENGTH_ERROR					0x6700
#define PROTOCOL_RES_CMD_NOT_ALLOWED_ERROR				0x6900
#define PROTOCOL_RES_SEC_CONDITION_NOT_SATISFIED_ERROR	0x6982
#define PROTOCOL_RES_SEC_PERMISSION_DENIED_ERROR		0x69F0
#define PROTOCOL_RES_WRONG_PARAMETERS_ERROR				0x6A00
#define PROTOCOL_RES_FUNCTION_NOT_SUPPORTED_ERROR		0x6A81
#define PROTOCOL_RES_INSUFFICIENT_MEMORY_ERROR			0x6A84
#define PROTOCOL_RES_REF_DATA_NOT_ROUND_ERROR			0x6A88
#define PROTOCOL_RES_FILE_ALREADY_EXISTS_ERROR			0x6A89
#define PROTOCOL_RES_INTERNAL_EXCEPTION_ERROR			0x6F00


#define PROTOCOL_PL_SIZE_DEVICE_INFO	0x0042

#define PROTOCOL_BEETWEN_DEVICE_INFO_1	0xC204
#define PROTOCOL_BEETWEN_DEVICE_INFO_2  0xC303
#define PROTOCOL_BEETWEN_DEVICE_INFO_3	0xC501
#define PROTOCOL_BEETWEN_DEVICE_INFO_4	0xC604
#define PROTOCOL_BEETWEN_DEVICE_INFO_5	0xC704
#define PROTOCOL_BEETWEN_DEVICE_INFO_6	0xC803
#define PROTOCOL_BEETWEN_DEVICE_INFO_7	0xC904
#define PROTOCOL_BEETWEN_DEVICE_INFO_8	0xCA04
#define PROTOCOL_BEETWEN_DEVICE_INFO_9	0xCB01
#define PROTOCOL_BEETWEN_DEVICE_INFO_10	0xCC03
#define PROTOCOL_BEETWEN_DEVICE_INFO_11	0xCD03
#define PROTOCOL_BEETWEN_DEVICE_INFO_12	0xCE03
#define PROTOCOL_BEETWEN_DEVICE_INFO_13	0xCE03



int protocolCheckMT(uint8_t MT);
int protocolCheckPayloadLength(uint16_t length);

uint16_t calculateCRC(uint8_t *data, uint16_t length);


/*
	Универсальная функция для парсинга приходящих пакетов. 
	Принимает новый	пришедший байт и контекст для каждого конкретного пакета 
	Возвращает <0 - если ошибка; 0 - если байт запарсен успешно; >0 - длина, если пакет запарсен успешно
*/

int parseNextByte(uint8_t newByte, tParcingContext *context);
```

## inc/ble_part.h
```c
/*
 * ble_part.h
 * inc
 * 
 * Copyright (C) 2025 by UHF Solutions
 * All right reserved
 */


#pragma once

#include <SEGGER_RTT.h>

#include <zephyr/kernel.h>
#include <zephyr/bluetooth/bluetooth.h>
#include <zephyr/bluetooth/conn.h>
#include <zephyr/bluetooth/gatt.h>
#include <zephyr/bluetooth/uuid.h>
#include <zephyr/bluetooth/services/bas.h>

#include "PROTOCOL.h"



#define THREAD_STACK_SIZE_BLE   8192
#define THREAD_PRIORITY_BLE     7


extern struct k_msgq ble_queue_tx;  // Очередь отправки пакетов по BLE

int ble_begin(uint16_t rx_timeout_ms, 
            struct bt_uuid_128 *transport_service_uuid, 
            struct bt_uuid_128 *transport_characteristic_in_uuid, 
            struct bt_uuid_128 *transport_characteristic_out_uuid);


// Обёртки - BAS
uint8_t ble_bas_get_battery_level();
uint8_t ble_bas_get_battery_level_status();

void ble_bas_set_battery_level(uint8_t value);
void ble_bas_set_battery_level_status(uint8_t value);
```

## inc/factory_data_part.h
```c
/*
 * factory_data_part.h
 * inc
 * 
 * Copyright (C) 2025 by UHF Solutions
 * All right reserved
 */
```

## inc/main.h
```c
/*
 * main.h
 * inc
 * 
 * Copyright (C) 2025 by UHF Solutions
 * All right reserved
 */

#pragma once

#include <SEGGER_RTT.h>

#include <zephyr/kernel.h>
#include <zephyr/drivers/gpio.h>

#include <zephyr/settings/settings.h>



#define THREAD_STACK_SIZE_MAIN  30000
#define THREAD_PRIORITY_MAIN    0
```

## inc/nvs_part.h
```c
/*
 * nvs_part.h
 * inc
 * 
 * Copyright (C) 2025 by UHF Solutions
 * All right reserved
 */

#include <SEGGER_RTT.h>

#include <zephyr/kernel.h>
#include <zephyr/settings/settings.h>
#include <zephyr/bluetooth/uuid.h>

#pragma once


#define NVS_PATH_FACTORY_DATA_FD_FLAGS                          "fd/FD_FLAGS"
#define NVS_PATH_FACTORY_DATA_FD_TAG_SN                         "fd/FD_TAG_SN"
#define NVS_PATH_FACTORY_DATA_FD_TAG_MODEL                      "fd/FD_TAG_MODEL"
#define NVS_PATH_FACTORY_DATA_FD_TAG_ANALOG_BOARD_ID            "fd/FD_TAG_ANALOG_BOARD_ID"
#define NVS_PATH_FACTORY_DATA_FD_TAG_SEED                       "fd/FD_TAG_SEED"
#define NVS_PATH_FACTORY_DATA_FD_TAG_ISSUER_PUBLIC_KEY          "fd/FD_TAG_ISSUER_PUBLIC_KEY"
#define NVS_PATH_FACTORY_DATA_FD_TAG_ISSUER_CERTIFICATE         "fd/FD_TAG_ISSUER_CERTIFICATE"
#define NVS_PATH_FACTORY_DATA_FD_TAG_DEVICE_CERTIFICATE         "fd/FD_TAG_DEVICE_CERTIFICATE"
#define NVS_PATH_FACTORY_DATA_FD_TAG_DEVICE_PRIVATE_KEY         "fd/FD_TAG_DEVICE_PRIVATE_KEY"
#define NVS_PATH_FACTORY_DATA_FD_TAG_IOT_CA_CERTIFICATE         "fd/FD_TAG_IOT_CA_CERTIFICATE"
#define NVS_PATH_FACTORY_DATA_FD_TAG_DEVICE_HUK_KCV             "fd/FD_TAG_DEVICE_HUK_KCV"
#define NVS_PATH_FACTORY_DATA_FD_TAG_PROFILES_ISSUER_PUBLIC_KEY "fd/FD_TAG_PRFLS_ISSR_PBLC_KY"
#define NVS_PATH_FACTORY_DATA_FD_TAG_BASE_USER_SETTINGS         "fd/FD_TAG_BASE_USER_SETTINGS"
#define NVS_PATH_FACTORY_DATA_FD_TAG_DEFAULT_LISENCE            "fd/FD_TAG_DEFAULT_LISENCE"
#define NVS_PATH_FACTORY_DATA_FD_TAG_SIGNATURE                  "fd/FD_TAG_SIGNATURE"



#define NVS_PATH_BT_UUID_TRANSPORT_SERVICE              "bt/uuid/transport/service"
#define NVS_PATH_BT_UUID_TRANSPORT_CHARACTERISTIC_IN    "bt/uuid/transport/in"
#define NVS_PATH_BT_UUID_TRANSPORT_CHARACTERISTIC_OUT   "bt/uuid/transport/out"

#define NVS_PATH_TIME_USB_RX_TIMEOUT   "time/usb_rx_timeout"
#define NVS_PATH_TIME_BLE_RX_TIMEOUT   "time/ble_rx_timeout"



int factory_data_load_fd_flags(uint8_t *buf);
int factory_data_load_fd_tag_sn(uint8_t *buf);
int factory_data_load_fd_tag_model(uint8_t *buf);
int factory_data_load_fd_tag_analog_board_id(uint8_t *buf);
int factory_data_load_fd_tag_seed(uint8_t *buf);
int factory_data_load_fd_tag_issuer_public_key(uint8_t *buf);
int factory_data_load_fd_tag_issuer_certificate(uint8_t *buf);
int factory_data_load_fd_tag_device_certificate(uint8_t *buf);
int factory_data_load_fd_tag_device_private_key(uint8_t *buf);
int factory_data_load_fd_tag_iot_ca_certificate(uint8_t *buf);
int factory_data_load_fd_tag_device_huk_kcv(uint8_t *buf);
int factory_data_load_fd_tag_profiles_issuer_public_key(uint8_t *buf);
int factory_data_load_fd_tag_base_user_settings(uint8_t *buf);
int factory_data_load_fd_tag_default_lisence(uint8_t *buf);
int factory_data_load_fd_tag_signature(uint8_t *buf);


int user_data_load_uuid_service(struct bt_uuid_128 *uuid);
int user_data_load_uuid_characteristic_in(struct bt_uuid_128 *uuid);
int user_data_load_uuid_characteristic_out(struct bt_uuid_128 *uuid);

int user_data_load_time_usb_rx_timeout(uint16_t *usb_rx_timeout);
int user_data_load_time_ble_rx_timeout(uint16_t *ble_rx_timeout);



#define NVS_SIZE_FD_FLAGS                            4
#define NVS_SIZE_FD_TAG_SN                           4
#define NVS_SIZE_FD_TAG_MODEL                        3
#define NVS_SIZE_FD_TAG_ANALOG_BOARD_ID              1
#define NVS_SIZE_FD_TAG_SEED                         32
#define NVS_SIZE_FD_TAG_ISSUER_PUBLIC_KEY            69
#define NVS_SIZE_FD_TAG_ISSUER_CERTIFICATE           1024
#define NVS_SIZE_FD_TAG_DEVICE_CERTIFICATE           1024
#define NVS_SIZE_FD_TAG_DEVICE_PRIVATE_KEY           40
#define NVS_SIZE_FD_TAG_IOT_CA_CERTIFICATE           1024
#define NVS_SIZE_FD_TAG_DEVICE_HUK_KCV               3
#define NVS_SIZE_FD_TAG_PROFILES_ISSUER_PUBLIC_KEY   69
#define NVS_SIZE_FD_TAG_BASE_USER_SETTINGS           4096
#define NVS_SIZE_FD_TAG_DEFAULT_LISENCE              4096
#define NVS_SIZE_FD_TAG_SIGNATURE                    69





#define NVS_FD_FLAGS                            { 0x00, 0x00, 0x00, 0x01, }
#define NVS_FD_TAG_SN                           { 0xD3, 0x00, 0x12, 0x34, }
#define NVS_FD_TAG_MODEL                        { 0x57, 0x11, 0x01, }
#define NVS_FD_TAG_ANALOG_BOARD_ID              { 0x80, }
#define NVS_FD_TAG_SEED                         32
#define NVS_FD_TAG_ISSUER_PUBLIC_KEY            { 0x45, 0x40, 0x2F, 0xF1, 0x4D, 0x88, 0x82, 0xA3, 0x97, 0xFF, 0xAB, 0xF7, 0xB0, 0xF7, 0xE8, 0xC8, 0x7D, 0x20, 0x81, 0x2C, 0x96, 0x84, 0x70, 0x76, 0x0B, 0xA2, 0x28, 0x20, 0xDE, 0x95, 0x78, 0xE8, 0x7F, 0xD2, 0x57, 0x0D, 0x9F, 0x49, 0xE4, 0xE7, 0xE3, 0xD6, 0x3C, 0xC0, 0x56, 0x94, 0xBD, 0x13, 0x9F, 0x5E, 0xCC, 0xE0, 0x63, 0x41, 0x85, 0x88, 0xEB, 0x3B, 0x43, 0xF2, 0x18, 0x8A, 0xC3, 0x49, 0xE1, 0x63, 0x47, 0x01, 0x10, }
#define NVS_FD_TAG_ISSUER_CERTIFICATE           { 0x58, 0x82, 0x01, 0xC3, 0x30, 0x82, 0x01, 0xBF, 0x30, 0x82, 0x01, 0x66, 0xA0, 0x03, 0x02, 0x01, 0x02, 0x02, 0x02, 0x10, 0x01, 0x30, 0x0A, 0x06, 0x08, 0x2A, 0x86, 0x48, 0xCE, 0x3D, 0x04, 0x03, 0x02, 0x30, 0x29, 0x31, 0x0D, 0x30, 0x0B, 0x06, 0x03, 0x55, 0x04, 0x0A, 0x0C, 0x04, 0x55, 0x48, 0x46, 0x53, 0x31, 0x18, 0x30, 0x16, 0x06, 0x03, 0x55, 0x04, 0x03, 0x0C, 0x0F, 0x46, 0x61, 0x63, 0x74, 0x6F, 0x72, 0x79, 0x20, 0x52, 0x6F, 0x6F, 0x74, 0x20, 0x43, 0x41, 0x30, 0x1E, 0x17, 0x0D, 0x32, 0x35, 0x30, 0x39, 0x31, 0x30, 0x32, 0x31, 0x35, 0x31, 0x31, 0x35, 0x5A, 0x17, 0x0D, 0x34, 0x35, 0x30, 0x39, 0x30, 0x35, 0x32, 0x31, 0x35, 0x31, 0x31, 0x35, 0x5A, 0x30, 0x32, 0x31, 0x0D, 0x30, 0x0B, 0x06, 0x03, 0x55, 0x04, 0x0A, 0x0C, 0x04, 0x55, 0x48, 0x46, 0x53, 0x31, 0x10, 0x30, 0x0E, 0x06, 0x03, 0x55, 0x04, 0x0B, 0x0C, 0x07, 0x46, 0x61, 0x63, 0x74, 0x6F, 0x72, 0x79, 0x31, 0x0F, 0x30, 0x0D, 0x06, 0x03, 0x55, 0x04, 0x03, 0x0C, 0x06, 0x4B, 0x52, 0x5A, 0x2D, 0x30, 0x31, 0x30, 0x59, 0x30, 0x13, 0x06, 0x07, 0x2A, 0x86, 0x48, 0xCE, 0x3D, 0x02, 0x01, 0x06, 0x08, 0x2A, 0x86, 0x48, 0xCE, 0x3D, 0x03, 0x01, 0x07, 0x03, 0x42, 0x00, 0x04, 0x54, 0xFE, 0xFA, 0xFC, 0x70, 0x22, 0x38, 0x11, 0x49, 0xAD, 0x5D, 0x94, 0x18, 0x17, 0x9A, 0x8A, 0x57, 0xFC, 0xEE, 0x01, 0xDF, 0xF5, 0xEC, 0x0D, 0xA6, 0xDF, 0x21, 0xDC, 0x58, 0x56, 0x0C, 0x02, 0x72, 0x31, 0x8F, 0x6A, 0x16, 0x37, 0x18, 0x9C, 0xD2, 0x5E, 0xAC, 0x01, 0x18, 0x05, 0xDF, 0xC3, 0xF0, 0x24, 0xA5, 0x51, 0x83, 0x9E, 0x3D, 0x7C, 0xAF, 0x3F, 0x01, 0x63, 0xC1, 0x55, 0x44, 0x45, 0xA3, 0x75, 0x30, 0x73, 0x30, 0x0C, 0x06, 0x03, 0x55, 0x1D, 0x13, 0x01, 0x01, 0xFF, 0x04, 0x02, 0x30, 0x00, 0x30, 0x0E, 0x06, 0x03, 0x55, 0x1D, 0x0F, 0x01, 0x01, 0xFF, 0x04, 0x04, 0x03, 0x02, 0x03, 0x88, 0x30, 0x13, 0x06, 0x03, 0x55, 0x1D, 0x25, 0x04, 0x0C, 0x30, 0x0A, 0x06, 0x08, 0x2B, 0x06, 0x01, 0x05, 0x05, 0x07, 0x03, 0x02, 0x30, 0x1D, 0x06, 0x03, 0x55, 0x1D, 0x0E, 0x04, 0x16, 0x04, 0x14, 0x68, 0x29, 0x67, 0x51, 0x61, 0x3E, 0x94, 0x68, 0x5D, 0x96, 0xFD, 0x3A, 0x48, 0x87, 0xC5, 0xF9, 0xC2, 0x83, 0x0F, 0xCE, 0x30, 0x1F, 0x06, 0x03, 0x55, 0x1D, 0x23, 0x04, 0x18, 0x30, 0x16, 0x80, 0x14, 0x04, 0x1F, 0xFD, 0xDC, 0x2B, 0xC7, 0x0F, 0x4F, 0x8F, 0x6C, 0x32, 0x25, 0x7E, 0xA8, 0x85, 0xE9, 0x53, 0x85, 0x9B, 0xF4, 0x30, 0x0A, 0x06, 0x08, 0x2A, 0x86, 0x48, 0xCE, 0x3D, 0x04, 0x03, 0x02, 0x03, 0x47, 0x00, 0x30, 0x44, 0x02, 0x20, 0x04, 0xC7, 0xA0, 0x76, 0x55, 0x0B, 0x7B, 0x04, 0x40, 0x8E, 0x82, 0x78, 0x9E, 0x71, 0xD9, 0x80, 0x05, 0x5D, 0xD0, 0x5F, 0x5F, 0xE8, 0x90, 0x75, 0x0F, 0x7D, 0x4C, 0xBD, 0x70, 0xB0, 0xD4, 0x95, 0x02, 0x20, 0x66, 0xAA, 0x74, 0xA4, 0x63, 0x17, 0x0D, 0xBF, 0xBF, 0xA9, 0xB6, 0xE2, 0xB0, 0xCC, 0x88, 0xA5, 0xDB, 0x18, 0xD9, 0x96, 0xD5, 0xE1, 0x36, 0x81, 0x99, 0x96, 0x01, 0x5E, 0x55, 0x28, 0xBF, 0x89, }
#define NVS_FD_TAG_DEVICE_CERTIFICATE           { 0x58, 0x82, 0x02, 0x18, 0x30, 0x82, 0x02, 0x14, 0x30, 0x82, 0x01, 0x75, 0xA0, 0x03, 0x02, 0x01, 0x02, 0x02, 0x02, 0x10, 0x08, 0x30, 0x0A, 0x06, 0x08, 0x2A, 0x86, 0x48, 0xCE, 0x3D, 0x04, 0x03, 0x02, 0x30, 0x2D, 0x31, 0x0D, 0x30, 0x0B, 0x06, 0x03, 0x55, 0x04, 0x0A, 0x0C, 0x04, 0x55, 0x48, 0x46, 0x53, 0x31, 0x1C, 0x30, 0x1A, 0x06, 0x03, 0x55, 0x04, 0x03, 0x0C, 0x13, 0x49, 0x6F, 0x54, 0x20, 0x44, 0x65, 0x76, 0x69, 0x63, 0x65, 0x73, 0x20, 0x52, 0x6F, 0x6F, 0x74, 0x20, 0x43, 0x41, 0x30, 0x1E, 0x17, 0x0D, 0x32, 0x35, 0x30, 0x39, 0x31, 0x30, 0x32, 0x31, 0x31, 0x37, 0x32, 0x31, 0x5A, 0x17, 0x0D, 0x33, 0x35, 0x30, 0x39, 0x31, 0x30, 0x32, 0x31, 0x31, 0x37, 0x32, 0x31, 0x5A, 0x30, 0x3D, 0x31, 0x11, 0x30, 0x0F, 0x06, 0x03, 0x55, 0x04, 0x0A, 0x0C, 0x08, 0x55, 0x48, 0x46, 0x53, 0x20, 0x49, 0x6F, 0x54, 0x31, 0x15, 0x30, 0x13, 0x06, 0x03, 0x55, 0x04, 0x03, 0x0C, 0x0C, 0x69, 0x6F, 0x74, 0x2D, 0x44, 0x33, 0x30, 0x30, 0x31, 0x32, 0x33, 0x34, 0x31, 0x11, 0x30, 0x0F, 0x06, 0x03, 0x55, 0x04, 0x05, 0x13, 0x08, 0x44, 0x33, 0x30, 0x30, 0x31, 0x32, 0x33, 0x34, 0x30, 0x59, 0x30, 0x13, 0x06, 0x07, 0x2A, 0x86, 0x48, 0xCE, 0x3D, 0x02, 0x01, 0x06, 0x08, 0x2A, 0x86, 0x48, 0xCE, 0x3D, 0x03, 0x01, 0x07, 0x03, 0x42, 0x00, 0x04, 0x0C, 0x1A, 0x5E, 0xB0, 0x28, 0xAB, 0x18, 0xAD, 0xAA, 0x25, 0xC4, 0xFD, 0x48, 0xC0, 0xB0, 0xC0, 0xE8, 0x62, 0xA5, 0xEB, 0xE5, 0x50, 0x96, 0xE9, 0x0C, 0x04, 0x66, 0x81, 0xCA, 0xDE, 0xD7, 0xA7, 0x37, 0x1C, 0xF8, 0x6E, 0xB5, 0xF2, 0x86, 0xB6, 0xCF, 0x90, 0xD5, 0x7A, 0x58, 0xD1, 0x5A, 0xEA, 0xC0, 0x06, 0x7A, 0x04, 0x8E, 0x8D, 0x1D, 0x41, 0x02, 0x1F, 0x1D, 0x6E, 0xC2, 0xD7, 0x7A, 0x7C, 0xA3, 0x75, 0x30, 0x73, 0x30, 0x0C, 0x06, 0x03, 0x55, 0x1D, 0x13, 0x01, 0x01, 0xFF, 0x04, 0x02, 0x30, 0x00, 0x30, 0x0E, 0x06, 0x03, 0x55, 0x1D, 0x0F, 0x01, 0x01, 0xFF, 0x04, 0x04, 0x03, 0x02, 0x03, 0x88, 0x30, 0x13, 0x06, 0x03, 0x55, 0x1D, 0x25, 0x04, 0x0C, 0x30, 0x0A, 0x06, 0x08, 0x2B, 0x06, 0x01, 0x05, 0x05, 0x07, 0x03, 0x02, 0x30, 0x1D, 0x06, 0x03, 0x55, 0x1D, 0x0E, 0x04, 0x16, 0x04, 0x14, 0x98, 0x2C, 0xF5, 0x38, 0x6A, 0x6F, 0x23, 0xCA, 0x1D, 0xB8, 0xB2, 0x9E, 0x36, 0xD8, 0x2C, 0x3D, 0x48, 0x73, 0x4E, 0xC7, 0x30, 0x1F, 0x06, 0x03, 0x55, 0x1D, 0x23, 0x04, 0x18, 0x30, 0x16, 0x80, 0x14, 0x73, 0x29, 0x20, 0x96, 0x8D, 0xCD, 0xAF, 0x00, 0x2E, 0x7A, 0x56, 0xFD, 0x37, 0x13, 0x1C, 0xF2, 0x9B, 0xA5, 0x71, 0xA1, 0x30, 0x0A, 0x06, 0x08, 0x2A, 0x86, 0x48, 0xCE, 0x3D, 0x04, 0x03, 0x02, 0x03, 0x81, 0x8C, 0x00, 0x30, 0x81, 0x88, 0x02, 0x42, 0x01, 0x5A, 0xAF, 0xAF, 0x5F, 0x7D, 0x6D, 0x1B, 0xCC, 0x5D, 0x68, 0xBC, 0xC3, 0x71, 0x59, 0xB5, 0x1F, 0xF7, 0xE3, 0x15, 0x96, 0xD8, 0xEC, 0xA9, 0x30, 0xD0, 0xFE, 0x07, 0xC6, 0xBB, 0xDD, 0xD8, 0x9D, 0x88, 0x4F, 0xF5, 0xE8, 0xC9, 0x55, 0x62, 0x1E, 0x15, 0x05, 0x5B, 0xC3, 0xD2, 0xB9, 0xF1, 0x0E, 0xDA, 0xBD, 0x1E, 0xCE, 0x77, 0x8A, 0xF1, 0x7A, 0x30, 0xC3, 0x67, 0x13, 0xD2, 0x0E, 0x06, 0x2B, 0x12, 0x02, 0x42, 0x00, 0xF9, 0x71, 0x15, 0x0D, 0xDF, 0x08, 0x15, 0x32, 0x97, 0x19, 0x2F, 0xC1, 0x94, 0xF4, 0x95, 0x96, 0x88, 0xD5, 0x5A, 0xAF, 0x62, 0x49, 0x60, 0x6D, 0x04, 0xF2, 0x99, 0xEB, 0xCC, 0x05, 0xF2, 0x02, 0x99, 0x77, 0xB5, 0x60, 0x84, 0xA1, 0x42, 0x64, 0xCA, 0x5F, 0x71, 0x19, 0xE2, 0x56, 0x54, 0x1E, 0x2D, 0x28, 0x26, 0x81, 0xD8, 0x7F, 0xEF, 0x5B, 0x02, 0xD7, 0xAD, 0x95, 0x39, 0x8F, 0xA9, 0x21, 0x9E, }
#define NVS_FD_TAG_DEVICE_PRIVATE_KEY           { 0x46, 0x20, 0x2A, 0xF1, 0x5B, 0xB3, 0x7A, 0x9B, 0xDA, 0x49, 0x7F, 0x65, 0xD1, 0xC5, 0x6A, 0x4A, 0xFD, 0xC5, 0x65, 0x69, 0x81, 0x1E, 0x3A, 0xDE, 0xC4, 0xC0, 0x3E, 0x7C, 0x1B, 0xA2, 0xED, 0x61, 0x57, 0xCE, 0x47, 0x01, 0x10, 0x48, 0x01, 0x04, }
#define NVS_FD_TAG_IOT_CA_CERTIFICATE           { 0x56, 0x82, 0x02, 0x4D, 0x30, 0x82, 0x02, 0x49, 0x30, 0x82, 0x01, 0xAB, 0xA0, 0x03, 0x02, 0x01, 0x02, 0x02, 0x14, 0x45, 0xB3, 0xF5, 0x21, 0xC2, 0x34, 0xE9, 0x0D, 0x1F, 0x4C, 0x69, 0xC9, 0x1A, 0xDA, 0xD3, 0xA9, 0x81, 0x98, 0x1C, 0x4E, 0x30, 0x0A, 0x06, 0x08, 0x2A, 0x86, 0x48, 0xCE, 0x3D, 0x04, 0x03, 0x04, 0x30, 0x2D, 0x31, 0x0D, 0x30, 0x0B, 0x06, 0x03, 0x55, 0x04, 0x0A, 0x0C, 0x04, 0x55, 0x48, 0x46, 0x53, 0x31, 0x1C, 0x30, 0x1A, 0x06, 0x03, 0x55, 0x04, 0x03, 0x0C, 0x13, 0x49, 0x6F, 0x54, 0x20, 0x44, 0x65, 0x76, 0x69, 0x63, 0x65, 0x73, 0x20, 0x52, 0x6F, 0x6F, 0x74, 0x20, 0x43, 0x41, 0x30, 0x1E, 0x17, 0x0D, 0x32, 0x35, 0x30, 0x39, 0x31, 0x30, 0x32, 0x30, 0x32, 0x32, 0x35, 0x39, 0x5A, 0x17, 0x0D, 0x34, 0x35, 0x30, 0x39, 0x31, 0x30, 0x32, 0x30, 0x32, 0x32, 0x35, 0x39, 0x5A, 0x30, 0x2D, 0x31, 0x0D, 0x30, 0x0B, 0x06, 0x03, 0x55, 0x04, 0x0A, 0x0C, 0x04, 0x55, 0x48, 0x46, 0x53, 0x31, 0x1C, 0x30, 0x1A, 0x06, 0x03, 0x55, 0x04, 0x03, 0x0C, 0x13, 0x49, 0x6F, 0x54, 0x20, 0x44, 0x65, 0x76, 0x69, 0x63, 0x65, 0x73, 0x20, 0x52, 0x6F, 0x6F, 0x74, 0x20, 0x43, 0x41, 0x30, 0x81, 0x9B, 0x30, 0x10, 0x06, 0x07, 0x2A, 0x86, 0x48, 0xCE, 0x3D, 0x02, 0x01, 0x06, 0x05, 0x2B, 0x81, 0x04, 0x00, 0x23, 0x03, 0x81, 0x86, 0x00, 0x04, 0x00, 0xC4, 0x1C, 0x62, 0x4E, 0x39, 0x62, 0xA3, 0xDE, 0xEE, 0x7F, 0x18, 0xAF, 0xE8, 0x16, 0xE8, 0x43, 0x18, 0x7F, 0x1F, 0xC7, 0xCA, 0x34, 0x20, 0x03, 0xAF, 0x7A, 0x36, 0xC4, 0xE3, 0xB8, 0x1A, 0x44, 0xAE, 0x97, 0x11, 0xDE, 0x66, 0xAF, 0x46, 0x4D, 0x75, 0x55, 0x24, 0x68, 0x5B, 0x12, 0xA2, 0xB3, 0xFB, 0xB9, 0x9E, 0xD4, 0x51, 0xC7, 0xA5, 0x6F, 0xF5, 0x23, 0xFF, 0x60, 0x56, 0x39, 0x35, 0x72, 0x3E, 0x01, 0xC4, 0x6E, 0xD2, 0xCD, 0x8C, 0xFD, 0xC4, 0x23, 0x13, 0xB7, 0xE0, 0x73, 0x80, 0x7A, 0x4C, 0x30, 0xA1, 0xC2, 0xD3, 0xF4, 0x17, 0xF6, 0x69, 0x65, 0xB9, 0x49, 0xF8, 0x06, 0x3F, 0x8B, 0x8D, 0x04, 0xAB, 0xB6, 0xFA, 0x0A, 0x19, 0xEA, 0xAC, 0x76, 0x50, 0x76, 0xCA, 0xCC, 0x36, 0xB7, 0x42, 0xA9, 0x35, 0x8C, 0x7D, 0x24, 0x48, 0x6F, 0x2C, 0x09, 0x5B, 0xEC, 0xFB, 0x21, 0x53, 0x77, 0xD4, 0xF8, 0x17, 0xA3, 0x66, 0x30, 0x64, 0x30, 0x12, 0x06, 0x03, 0x55, 0x1D, 0x13, 0x01, 0x01, 0xFF, 0x04, 0x08, 0x30, 0x06, 0x01, 0x01, 0xFF, 0x02, 0x01, 0x00, 0x30, 0x0E, 0x06, 0x03, 0x55, 0x1D, 0x0F, 0x01, 0x01, 0xFF, 0x04, 0x04, 0x03, 0x02, 0x01, 0x06, 0x30, 0x1D, 0x06, 0x03, 0x55, 0x1D, 0x0E, 0x04, 0x16, 0x04, 0x14, 0x73, 0x29, 0x20, 0x96, 0x8D, 0xCD, 0xAF, 0x00, 0x2E, 0x7A, 0x56, 0xFD, 0x37, 0x13, 0x1C, 0xF2, 0x9B, 0xA5, 0x71, 0xA1, 0x30, 0x1F, 0x06, 0x03, 0x55, 0x1D, 0x23, 0x04, 0x18, 0x30, 0x16, 0x80, 0x14, 0x73, 0x29, 0x20, 0x96, 0x8D, 0xCD, 0xAF, 0x00, 0x2E, 0x7A, 0x56, 0xFD, 0x37, 0x13, 0x1C, 0xF2, 0x9B, 0xA5, 0x71, 0xA1, 0x30, 0x0A, 0x06, 0x08, 0x2A, 0x86, 0x48, 0xCE, 0x3D, 0x04, 0x03, 0x04, 0x03, 0x81, 0x8B, 0x00, 0x30, 0x81, 0x87, 0x02, 0x42, 0x01, 0x83, 0x1F, 0x7C, 0x8A, 0x9D, 0x74, 0x09, 0xF6, 0xB0, 0x90, 0x4B, 0x4C, 0x42, 0xD1, 0x55, 0x85, 0x8B, 0x3F, 0x11, 0x2E, 0x11, 0x5D, 0x1B, 0x4F, 0xD5, 0xD1, 0x48, 0xE7, 0x5A, 0x2B, 0x4E, 0xAE, 0x9A, 0x3A, 0xAF, 0xCD, 0xCA, 0xC6, 0xC5, 0xCB, 0x3D, 0xE8, 0xC1, 0x56, 0x5B, 0xDC, 0xC6, 0xF9, 0xBD, 0xC5, 0xE2, 0xE9, 0xE9, 0xB4, 0x9B, 0xE3, 0x6A, 0x87, 0xFD, 0xDE, 0x9D, 0x80, 0x5F, 0x60, 0xA5, 0x02, 0x41, 0x7B, 0x0D, 0x3E, 0xDF, 0x8F, 0x69, 0xE4, 0xDE, 0x53, 0x80, 0xE5, 0x88, 0xCA, 0xBF, 0x53, 0xB8, 0x1E, 0x0A, 0xA1, 0xA8, 0x3A, 0xF5, 0x7D, 0x7F, 0xC0, 0xDC, 0x31, 0x7D, 0x3B, 0xFB, 0x1C, 0x2B, 0x13, 0x16, 0xE0, 0x6B, 0x30, 0xFF, 0xCD, 0x4D, 0x2A, 0x0E, 0x99, 0xAA, 0x99, 0xDD, 0x37, 0xAF, 0xCC, 0x5B, 0x80, 0x38, 0x19, 0xC1, 0x14, 0x1D, 0xBE, 0xC7, 0x4C, 0xE9, 0xEE, 0xD9, 0xCA, 0xC5, 0x02, }
#define NVS_FD_TAG_DEVICE_HUK_KCV               3
#define NVS_FD_TAG_PROFILES_ISSUER_PUBLIC_KEY   { 0x45, 0x40, 0x2F, 0xF1, 0x4D, 0x88, 0x82, 0xA3, 0x97, 0xFF, 0xAB, 0xF7, 0xB0, 0xF7, 0xE8, 0xC8, 0x7D, 0x20, 0x81, 0x2C, 0x96, 0x84, 0x70, 0x76, 0x0B, 0xA2, 0x28, 0x20, 0xDE, 0x95, 0x78, 0xE8, 0x7F, 0xD2, 0x57, 0x0D, 0x9F, 0x49, 0xE4, 0xE7, 0xE3, 0xD6, 0x3C, 0xC0, 0x56, 0x94, 0xBD, 0x13, 0x9F, 0x5E, 0xCC, 0xE0, 0x63, 0x41, 0x85, 0x88, 0xEB, 0x3B, 0x43, 0xF2, 0x18, 0x8A, 0xC3, 0x49, 0xE1, 0x63, 0x47, 0x01, 0x10, }
#define NVS_FD_TAG_BASE_USER_SETTINGS           4096
#define NVS_FD_TAG_DEFAULT_LISENCE              4096
#define NVS_FD_TAG_SIGNATURE                    { 0x4D, 0x40, 0x16, 0x59, 0x23, 0x55, 0x42, 0x30, 0x30, 0xC3, 0xF6, 0x3E, 0x93, 0xFC, 0x14, 0x1A, 0x99, 0x10, 0x43, 0x2F, 0xCC, 0xB8, 0xB1, 0x28, 0xFA, 0xC5, 0xB4, 0x49, 0xC9, 0x82, 0xE6, 0xD6, 0x4B, 0x62, 0x1C, 0x2E, 0xC7, 0xBE, 0x8C, 0xB0, 0xA1, 0xF7, 0xF7, 0xEC, 0x5B, 0x04, 0xE7, 0x37, 0x75, 0xEF, 0x54, 0x57, 0x30, 0xA8, 0x21, 0xEC, 0x3A, 0x7E, 0x30, 0xC0, 0xD6, 0xFC, 0xCF, 0x1B, 0xC6, 0x35, 0x47, 0x01, 0x10, }


int settings_init_save();
```

## inc/packet_build.h
```c
/*
 * packet_build.h
 * inc
 * 
 * Copyright (C) 2025 by UHF Solutions
 * All right reserved
 */

 #pragma once

 #include <zephyr/kernel.h>
 
 #include "PROTOCOL.h"
 #include "nvs_part.h"

 
void buildGetDeviceInfo(tUniversalMessage *pkt);
```

## inc/parser.h
```c
/*
 * parser.h
 * inc
 * 
 * Copyright (C) 2025 by UHF Solutions
 * All right reserved
 */

#pragma once

#include <SEGGER_RTT.h>

#include <zephyr/kernel.h>
#include "PROTOCOL.h"



#define THREAD_STACK_SIZE_PARSER   16384
#define THREAD_PRIORITY_PARSER     7


extern struct k_msgq parser_queue;  // Очередь парсера


void _DEBUG_printBuffer(const char *prefix, uint8_t *data, uint16_t length);
```

## inc/usb_part.h
```c
/*
 * usb_part.h
 * inc
 * 
 * Copyright (C) 2025 by UHF Solutions
 * All right reserved
 */


#pragma once

#include <SEGGER_RTT.h>

#include <stdio.h>
#include <string.h>
#include <zephyr/device.h>
#include <zephyr/drivers/uart.h>
#include <zephyr/kernel.h>
#include <zephyr/sys/ring_buffer.h>

#include <zephyr/usb/usb_device.h>
#include <zephyr/usb/usbd.h>

#include "PROTOCOL.h"



#define THREAD_STACK_SIZE_USB   8192
#define THREAD_PRIORITY_USB     7


extern struct k_msgq usb_queue_tx;  // Очередь отправки пакетов по USB

int usb_begin(uint16_t rx_timeout_ms);
```

## src/PROTOCOL.c
```c
/*
 * PROTOCOL.c
 * src
 * 
 * Copyright (C) 2025 by UHF Solutions
 * All right reserved
 */


#include "PROTOCOL.h"


K_HEAP_DEFINE(UniversalTransportHeap, UNIVERSAL_TRANSPORT_HEAP_SIZE);



int heapFreeWithCheck(struct k_heap *heap, void *data) 
{
	if (heap == NULL || data == NULL)
	{
		return -EINVAL;
	}

	k_heap_free(heap, data);
	return 0;
}

uint16_t calculateCRC(uint8_t *data, uint16_t length)
{
	uint16_t crc = 0xFFFF;
  
	for (uint16_t i = 1; i < length; i++) 
	{
		crc ^= (uint16_t)data[i] << 8;
		
		for (uint8_t j = 0; j < 8; j++) 
		{
			if (crc & 0x8000)
				crc = (crc << 1) ^ 0x1021;
			else
				crc <<= 1;
			
		}
	}
  
  return crc;
}



// *******************************************************************
// Проверки заголовка
// *******************************************************************


int protocolCheckMT(uint8_t MT) 
{ 
	uint8_t messageTypes[] = PROTOCOL_MSG_TYPES;

	for (int i = 0; i < sizeof(messageTypes); i++) 
	{
		if (MT == messageTypes[i])
		{
			return 0; 
		}
	}
	
	return -EPROTO;
}

int protocolCheckPayloadLength(uint16_t length) 
{ 
	if (length <= PROTOCOL_MAX_PACKET_LENGTH)
	{
		return 0;
	}

	return -EMSGSIZE;
}



// *******************************************************************
// Парсинг
// *******************************************************************

int processByte(uint8_t newByte, tParcingContext *context) 
{
	context->rxPacket->data[context->rxPacket->length] = newByte;


	switch (context->rxPacket->length) // Проверки заголовка пакета
	{
	case PROTOCOL_INDEX_MSG_TYPE:
		if (protocolCheckMT(newByte) < 0)
			return -EPROTO;
		break;
	case PROTOCOL_INDEX_MSG_CODE:
		break;
	case PROTOCOL_INDEX_PL_LEN_MSB:
		context->payloadLength = newByte;
		context->payloadLength <<= 8;
		break;
	case PROTOCOL_INDEX_PL_LEN_LSB:
		context->payloadLength |= newByte;
		if (protocolCheckPayloadLength(context->payloadLength) < 0)
			return -EMSGSIZE;
		break;
	};

	if (context->rxPacket->length == PROTOCOL_INDEX_PL_LEN_LSB) // Расширяем буфер для данных пакета
	{
		context->rxPacket->data =
			k_heap_realloc(&UniversalTransportHeap, context->rxPacket->data, PROTOCOL_INDEX_PL_START+context->payloadLength+PROTOCOL_END_PART_SIZE, K_NO_WAIT);

		if (!context->rxPacket->data)
			return -ENOMEM;
	}

	if (context->rxPacket->length > PROTOCOL_INDEX_PL_START) // Проверки окончания пакета
	{
		if (context->rxPacket->length == PROTOCOL_INDEX_PL_START+context->payloadLength) // END MARK
		{
			if (newByte != PROTOCOL_END_MARK)
				return -EPROTO;
		}
		else if (context->rxPacket->length == PROTOCOL_INDEX_PL_START+context->payloadLength+1) // CRC MSB
		{
			context->checksumBuffer = newByte;
			context->checksumBuffer <<= 8;
		}
		else if (context->rxPacket->length == PROTOCOL_INDEX_PL_START+context->payloadLength+2) // CRC LSB
		{
			context->checksumBuffer |= newByte;

			uint16_t crcCalculatedBuf = calculateCRC(context->rxPacket->data, PROTOCOL_INDEX_PL_START+context->payloadLength+1);
			if (context->checksumBuffer != crcCalculatedBuf)
			{
				return -EBADMSG;
			}

			return ++context->rxPacket->length;
		}
	}

	context->rxPacket->length++;
	return 0;
}

int parseNextByte(uint8_t newByte, tParcingContext *context) 
{
	int err = 0;

	if (context->rxPacket == NULL) // Пропускаем мусор, ждём начала пакета
	{
		if (newByte == 0xBB) // Инициализируем структуру
		{
			context->rxPacket = k_heap_alloc(&UniversalTransportHeap, sizeof(tUniversalMessage), K_NO_WAIT);
			if (!context->rxPacket)
			{
				return -EAGAIN;
			}

			context->rxPacket->data = k_heap_alloc(&UniversalTransportHeap, PROTOCOL_INDEX_PL_START, K_NO_WAIT);
			if (!context->rxPacket->data)
			{
				return -ENOMEM;
			}			

			context->rxPacket->source = 0;
			context->rxPacket->length = 0;
		}
	}

	if (context->rxPacket) // Парсим
	{
		err = processByte(newByte, context);

		if (err < 0)
		{
			freeUniversalMessage(context->rxPacket);
			freeParcingContex(context);
		}
		
		return err;
	}

	return 0;
}



// *******************************************************************
// Очистки контекста
// *******************************************************************

void freeUniversalMessage(tUniversalMessage *packet) 
{
	if (packet)
	{
		heapFreeWithCheck(&UniversalTransportHeap, packet);

		if (packet->data)
			heapFreeWithCheck(&UniversalTransportHeap, packet->data);			
	}
}

void freeParcingContex(tParcingContext *context) 
{
	if (context)
	{		
		context->rxPacket = NULL;
		context->payloadLength = 0;
		context->checksumBuffer = 0;
	}
}
```

## src/ble_part.cpp
```c
#include "ble_part.h"


struct bt_conn *ble_device = nullptr;

static struct k_work restart_adv_work;

static bool initialized = false;
static bool connected = false;



// *******************************************************************
// Adverstiment
// *******************************************************************

static struct bt_le_ext_adv *adv;

const struct bt_le_adv_param adv_params = {
    .options = BT_LE_ADV_OPT_CONN,
    .interval_min = BT_GAP_ADV_FAST_INT_MIN_2,
    .interval_max = BT_GAP_ADV_FAST_INT_MAX_2,
};
static uint8_t adv_flags = BT_LE_AD_GENERAL | BT_LE_AD_NO_BREDR;

static struct bt_data adv_data[4]; 


// TRANSPORT 
static bt_gatt_service transport_service;

static struct bt_gatt_chrc TRANSPORT_CHARACTERITIC_IN;
static struct bt_gatt_chrc TRANSPORT_CHARACTERITIC_OUT;
static struct _bt_gatt_ccc TRANSPORT_CCC;

static struct bt_gatt_attr TRANSPORT_ATTRIBUTES[6];


static uint8_t BT_TRANSPORT_In;
static uint8_t BT_TRANSPORT_Out;

static bool transport_notify_out = false;


// BAS
static uint8_t BT_BAS_BatteryLevel = 0;
static uint8_t BT_BAS_BatteryLevelStatus = 0x01;

static bool bas_notify_battery_level = false;
static bool bas_notify_battery_level_status = false;



// *******************************************************************
// Коллбэки
// *******************************************************************

static void BT_MTU_UPDATED(struct bt_conn *conn, uint16_t tx, uint16_t rx)
{
    printk(" --- BLE --- :  Updated MTU: TX %d RX %d bytes\n", tx, rx);
}

// Подключение/Отключение
static void BT_CONNECTED(struct bt_conn *conn, uint8_t err)
{
    connected = true;

    if (err == 0)
    {
        ble_device = bt_conn_ref(conn);
        printk(" --- BLE --- :  Connected\n");
    } 
    else
        printk(" --- BLE ERR --- :  Bluetooth connected Failed!\n");
}

static void BT_DISCONNECTED(struct bt_conn *conn, uint8_t reason)
{
    int err= 0;
    connected = false;

    if (ble_device) 
    {
        bt_conn_unref(conn);
        ble_device = nullptr;

        printk(" --- BLE --- :  Disconnected\n");
    }
    else 
        printk(" --- BLE ERR --- :  Bluetooth device delete Failed!\n");


    k_work_submit(&restart_adv_work);
}


// Сервис - TRANSPORT
static ssize_t BT_TRANSPORT_read_state(struct bt_conn *conn,
                                       const struct bt_gatt_attr *attr, void *buf,
                                       uint16_t len, uint16_t offset)
{
    const uint8_t *val = (uint8_t*)attr->user_data;
    return bt_gatt_attr_read(conn, attr, buf, len, offset, val, sizeof(*val));
}

static ssize_t BT_TRANSPORT_write_state(struct bt_conn *conn,
                                        const struct bt_gatt_attr *attr, const void *buf,
                                        uint16_t len, uint16_t offset, uint8_t flags)
{
    if (offset != 0 || len != 1)
	{
		printk("Too big message! Maximum is 1 byte\n");
        return BT_GATT_ERR(BT_ATT_ERR_INVALID_ATTRIBUTE_LEN);
	}

    BT_TRANSPORT_In = *((uint8_t*)buf);
	printk("Transport IN New Value: %d\n", BT_TRANSPORT_In);

	BT_TRANSPORT_Out = BT_TRANSPORT_In;
	if (transport_notify_out)
		bt_gatt_notify(ble_device, &TRANSPORT_ATTRIBUTES[4], &BT_TRANSPORT_Out, sizeof(BT_TRANSPORT_Out));

    return len;
}

// Notification - TRANSPORT
static void BT_NOTIFICATIONS_TRANSPORT_OUT(const struct bt_gatt_attr *attr, uint16_t value)
{
    bool notify = (value == BT_GATT_CCC_NOTIFY) ? true : false;

    transport_notify_out = notify;
	printk(" --- BLE Notification --- :  Transport OUT Notification %s\n", notify ? "enabled" : "disabled");
}


// Сервис - BAS
static ssize_t BT_BAS_read_state(struct bt_conn *conn,
                                 const struct bt_gatt_attr *attr, void *buf,
                                 uint16_t len, uint16_t offset)
{
    uint8_t *val = (uint8_t*)attr->user_data;
    if (!val) return BT_GATT_ERR(BT_ATT_ERR_INVALID_ATTRIBUTE_LEN);
    return bt_gatt_attr_read(conn, attr, buf, len, offset, val, sizeof(*val));
}

// Notification - BAS
static void BT_NOTIFICATIONS_BAS_BATTERY_LEVEL(const struct bt_gatt_attr *attr, uint16_t value)
{
    bool notify = (value == BT_GATT_CCC_NOTIFY) ? true : false;

    bas_notify_battery_level = notify;
    printk(" --- BLE Notification --- :  Battery Level Notification %s\n", notify ? "enabled" : "disabled");
}

static void BT_NOTIFICATIONS_BAS_BATTERY_LEVEL_STATUS(const struct bt_gatt_attr *attr, uint16_t value) 
{
    bool notify = (value == BT_GATT_CCC_NOTIFY) ? true : false;

    bas_notify_battery_level_status = notify;
    printk(" --- BLE Notification --- :  Battery Level Status Notification %s\n", notify ? "enabled" : "disabled");    
}



// *******************************************************************
// GATT сервисы
// *******************************************************************

BT_GATT_SERVICE_DEFINE(bas_service,
    BT_GATT_PRIMARY_SERVICE(BT_UUID_BAS),
    
    BT_GATT_CHARACTERISTIC(BT_UUID_BAS_BATTERY_LEVEL,
                           BT_GATT_CHRC_READ | BT_GATT_CHRC_NOTIFY,
                           BT_GATT_PERM_READ,
                           BT_BAS_read_state, NULL, &BT_BAS_BatteryLevel),
    BT_GATT_CCC(BT_NOTIFICATIONS_BAS_BATTERY_LEVEL, BT_GATT_PERM_READ | BT_GATT_PERM_WRITE),

    BT_GATT_CHARACTERISTIC(BT_UUID_BAS_BATTERY_LEVEL_STATUS,
                           BT_GATT_CHRC_READ | BT_GATT_CHRC_NOTIFY,
                           BT_GATT_PERM_READ,
                           BT_BAS_read_state, NULL, &BT_BAS_BatteryLevelStatus),
    BT_GATT_CCC(BT_NOTIFICATIONS_BAS_BATTERY_LEVEL_STATUS, BT_GATT_PERM_READ | BT_GATT_PERM_WRITE)
);



// *******************************************************************
// Инициализация BLE
// *******************************************************************

BT_CONN_CB_DEFINE(conn_callbacks) = {
    .connected = BT_CONNECTED,
    .disconnected = BT_DISCONNECTED,
};

static struct bt_gatt_cb gatt_callbacks = {
    .att_mtu_updated = BT_MTU_UPDATED,
};


static void restart_adv(struct k_work *work)
{
    uint8_t err;

    bt_le_ext_adv_stop(adv);

    err = bt_le_ext_adv_start(adv, BT_LE_EXT_ADV_START_DEFAULT);
    if (err < 0)
        printk(" --- BLE ERR --- :  Failed to restart advertising: %d\n", err);
    else
        printk(" --- BLE --- :  Successful restart advertising\n");
}


int ble_prepare_transport_service(bt_uuid_128 *transport_service_uuid, 
            bt_uuid_128 *transport_characteristic_in_uuid, 
            bt_uuid_128 *transport_characteristic_out_uuid)
{
	TRANSPORT_CHARACTERITIC_IN =
		{
			.uuid = &transport_characteristic_in_uuid->uuid,
			.value_handle = 0, // Заполнится стеком
			.properties = BT_GATT_CHRC_WRITE,
		};

	TRANSPORT_CHARACTERITIC_OUT =
		{
			.uuid = &transport_characteristic_out_uuid->uuid,
			.value_handle = 0, // Заполнится стеком 
			.properties = BT_GATT_CHRC_READ | BT_GATT_CHRC_NOTIFY,
		};

	TRANSPORT_CCC = BT_GATT_CCC_INITIALIZER(BT_NOTIFICATIONS_TRANSPORT_OUT, NULL, NULL);

	struct bt_gatt_attr temp[6] =
	{
			BT_GATT_PRIMARY_SERVICE(transport_service_uuid),

			// Характеристика IN
			BT_GATT_ATTRIBUTE(BT_UUID_GATT_CHRC,
							  BT_GATT_PERM_READ,
							  bt_gatt_attr_read_chrc,
							  NULL,
							  &TRANSPORT_CHARACTERITIC_IN),

			BT_GATT_ATTRIBUTE(TRANSPORT_CHARACTERITIC_IN.uuid,
							  BT_GATT_PERM_READ | BT_GATT_PERM_WRITE,
							  BT_TRANSPORT_read_state, BT_TRANSPORT_write_state, &BT_TRANSPORT_In),

			// Характеристика OUT
			BT_GATT_ATTRIBUTE(BT_UUID_GATT_CHRC,
							  BT_GATT_PERM_READ,
							  bt_gatt_attr_read_chrc,
							  NULL,
							  &TRANSPORT_CHARACTERITIC_OUT),

			BT_GATT_ATTRIBUTE(TRANSPORT_CHARACTERITIC_OUT.uuid,
							  BT_GATT_PERM_READ,
							  BT_TRANSPORT_read_state, BT_TRANSPORT_write_state, &BT_TRANSPORT_Out),

			// Настройка Notification
			BT_GATT_ATTRIBUTE(BT_UUID_GATT_CCC,
							  BT_GATT_PERM_READ | BT_GATT_PERM_WRITE,
							  bt_gatt_attr_read_ccc,
							  bt_gatt_attr_write_ccc,
							  &TRANSPORT_CCC),
	};
	memcpy(TRANSPORT_ATTRIBUTES, temp, sizeof(temp));

    transport_service.attrs = TRANSPORT_ATTRIBUTES;
    transport_service.attr_count = ARRAY_SIZE(TRANSPORT_ATTRIBUTES);

    return bt_gatt_service_register(&transport_service);
}


int ble_begin(bt_uuid_128 *transport_service_uuid, 
            bt_uuid_128 *transport_characteristic_in_uuid, 
            bt_uuid_128 *transport_characteristic_out_uuid)
{
    int err= 0;
    
    k_work_init(&restart_adv_work, restart_adv);


    // Добавляем транспортный сервис
    err = ble_prepare_transport_service(transport_service_uuid, transport_characteristic_in_uuid, transport_characteristic_out_uuid);
    if (err < 0)
    {
        printk(" --- BLE ERR --- :  Register Transport Service Failed: %d\n", err);
        return err;
    }
    else 
        printk(" --- BLE --- :  Transport Service successful added\n");


    // Настраиваем Advertisement
    adv_data[0].type = BT_DATA_FLAGS;
    adv_data[0].data_len = 1;
    adv_data[0].data = &adv_flags;

    adv_data[1].type = BT_DATA_NAME_COMPLETE;
    adv_data[1].data_len = strlen(CONFIG_BT_DEVICE_NAME);
    adv_data[1].data = (const uint8_t *)CONFIG_BT_DEVICE_NAME;

    adv_data[2].type = BT_DATA_UUID16_ALL;
    adv_data[2].data_len = BT_UUID_SIZE_16;
    adv_data[2].data = (const uint8_t *)BT_UUID_16_ENCODE(BT_UUID_BAS_VAL);

    adv_data[3].type = BT_DATA_UUID128_SOME;
    adv_data[3].data_len = BT_UUID_SIZE_128;
    adv_data[3].data = transport_service_uuid->val;    


    // Инициализируем и запускаем стек
    err = bt_enable(NULL);
    if (err < 0) 
    {
        printk(" --- BLE ERR --- :  Bluetooth enable Failed: %d\n", err);
        return err;
    }

	err = bt_le_ext_adv_create(BT_LE_EXT_ADV_CONN, NULL, &adv);
    if (err < 0) 
    {
        printk(" --- BLE ERR --- :  Advertisement create Failed: %d\n", err);
        return err;
    }


	err = bt_le_ext_adv_set_data(adv, adv_data, ARRAY_SIZE(adv_data), NULL, 0);
    if (err < 0) 
    {
        printk(" --- BLE ERR --- :  Set data to advertising Failed: %d\n", err);
        return err;
    }

    bt_gatt_cb_register(&gatt_callbacks);


	err = bt_le_ext_adv_start(adv, BT_LE_EXT_ADV_START_DEFAULT);
    if (err < 0) 
    {
        printk(" --- BLE ERR --- :  Begin advetisement start Failed: %d\n", err);
        return err;
    }

    initialized = true;
    printk(" --- BLE --- :  Successful Initialized!\n");
    return 0;    
}



// *******************************************************************
// Обёртки для сервисов
// *******************************************************************

uint8_t ble_bas_get_battery_level() 
{
    return BT_BAS_BatteryLevel;
}

uint8_t ble_bas_get_battery_level_status() 
{
    return BT_BAS_BatteryLevelStatus;
}


int ble_bas_set_battery_level(uint8_t value) 
{
    int err= 0;
    
    if (!connected)
        return -EAGAIN;

    BT_BAS_BatteryLevel = value;

    if (bas_notify_battery_level)
        err = bt_gatt_notify(ble_device, &bas_service.attrs[2], &BT_BAS_BatteryLevel, sizeof(BT_BAS_BatteryLevel));
    return err;
}

int ble_bas_set_battery_level_status(uint8_t value) 
{
    int err= 0;
    
    if (!connected)
        return -EAGAIN;

    BT_BAS_BatteryLevelStatus = value & 0x0F;

    if (bas_notify_battery_level_status)
        err = bt_gatt_notify(ble_device, &bas_service.attrs[4], &BT_BAS_BatteryLevelStatus, sizeof(BT_BAS_BatteryLevelStatus));
    return err;
}
```
